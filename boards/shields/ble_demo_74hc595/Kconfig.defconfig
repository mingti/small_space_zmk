## boards/shields/ble_demo_74hc595/Kconfig.defconfig
```kconfig
if SHIELD_BLE_DEMO_74HC595

config ZMK_KEYBOARD_NAME
    default "ble_demo_595"

config SPI
    default y

endif # SHIELD_BLE_DEMO_74HC595
```

## boards/shields/ble_demo_74hc595/Kconfig.shield
```kconfig
config SHIELD_BLE_DEMO_74HC595
    def_bool $(shields_list_contains,ble_demo_74hc595)
```

## boards/shields/ble_single_key/Kconfig.defconfig
```kconfig
if SHIELD_BLE_SINGLE_KEY

config ZMK_KEYBOARD_NAME
    default "ble_single_key"

endif # SHIELD_BLE_SINGLE_KEY
```

## boards/shields/ble_single_key/Kconfig.shield
```kconfig
config SHIELD_BLE_SINGLE_KEY
    def_bool $(shields_list_contains,ble_single_key)
```

## boards/shields/grid25/Kconfig.defconfig
```kconfig
if SHIELD_GRID25

config ZMK_KEYBOARD_NAME
    default "grid25"

config SPI
    default y

endif # SHIELD_GRID25
```

## boards/shields/small_space/Kconfig.defconfig
```kconfig
if SHIELD_SMALL_SPACE

config ZMK_KEYBOARD_NAME
    default "small_space"

endif # SHIELD_SMALL_SPACE
```

## config/boards/shields/single_key_test/Kconfig.shield
```kconfig
config SHIELD_SINGLE_KEY_TEST
    def_bool $(shields_list_contains,single_key_test)
```

## config/boards/shields/small_space/Kconfig.defconfig
```kconfig
if SHIELD_SMALL_SPACE

config ZMK_KEYBOARD_NAME
    default "small_space"

endif
```

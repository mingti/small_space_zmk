/ {
    chosen {
        zmk,kscan = &kscan0;
    };

    kscan0: kscan {
        compatible = "zmk,kscan-gpio-matrix";
        label = "KSCAN";
        diode-direction = "col2row"; 

        // 16路列（由两片 74HC165 串联提供）
        col-gpios
            = <&shifter 0 GPIO_ACTIVE_LOW>
            , <&shifter 1 GPIO_ACTIVE_LOW>
            , <&shifter 2 GPIO_ACTIVE_LOW>
            , <&shifter 3 GPIO_ACTIVE_LOW>
            , <&shifter 4 GPIO_ACTIVE_LOW>
            , <&shifter 5 GPIO_ACTIVE_LOW>
            , <&shifter 6 GPIO_ACTIVE_LOW>
            , <&shifter 7 GPIO_ACTIVE_LOW>
            , <&shifter 8 GPIO_ACTIVE_LOW>
            , <&shifter 9 GPIO_ACTIVE_LOW>
            , <&shifter 10 GPIO_ACTIVE_LOW>
            , <&shifter 11 GPIO_ACTIVE_LOW>
            , <&shifter 12 GPIO_ACTIVE_LOW>
            , <&shifter 13 GPIO_ACTIVE_LOW>
            , <&shifter 14 GPIO_ACTIVE_LOW>
            , <&shifter 15 GPIO_ACTIVE_LOW>
            ;

        // 6路行（直接连 MCU，避开 D1）
        row-gpios
            = <&gpio0 8  (GPIO_ACTIVE_LOW | GPIO_PULL_UP)> // D2
            , <&gpio1 4  (GPIO_ACTIVE_LOW | GPIO_PULL_UP)> // D6
            , <&gpio1 6  (GPIO_ACTIVE_LOW | GPIO_PULL_UP)> // D7
            , <&gpio0 11 (GPIO_ACTIVE_LOW | GPIO_PULL_UP)> // D8
            , <&gpio0 10 (GPIO_ACTIVE_LOW | GPIO_PULL_UP)> // D9
            , <&gpio0 9  (GPIO_ACTIVE_LOW | GPIO_PULL_UP)> // D10
            ;
    };

    // 移位寄存器虚拟节点
    shifter: gpio_shifter {
        compatible = "zmk,gpio-595"; 
        label = "74HC165";
        gpio-controller;
        #gpio-cells = <2>;
        ngpios = <16>;
        clock-gpios = <&gpio0 20 GPIO_ACTIVE_HIGH>; // D3
        latch-gpios = <&gpio0 22 GPIO_ACTIVE_HIGH>; // D4
        data-gpios  = <&gpio1 0 GPIO_ACTIVE_HIGH>;  // D5
    };
};